## src/mainboard/hp/snb_ivb_laptops/variants/probook_6560b/Kconfig
```kconfig
## SPDX-License-Identifier: GPL-2.0-only

if BOARD_HEWLETT_PACKARD_HP_PROBOOK_6560B

config BOARD_SPECIFIC_OPTIONS
	def_bool y
	select AZALIA_USE_LEGACY_VERB_TABLE
	select BOARD_ROMSIZE_KB_4096
	select EC_ACPI
	select HAVE_ACPI_RESUME
	select HAVE_ACPI_TABLES
	select INTEL_INT15
	select MAINBOARD_HAS_LIBGFXINIT # FIXME: check this
	select NORTHBRIDGE_INTEL_SANDYBRIDGE
	select SERIRQ_CONTINUOUS_MODE
	select SOUTHBRIDGE_INTEL_BD82X6X
	select SYSTEM_TYPE_LAPTOP
	select USE_NATIVE_RAMINIT

config MAINBOARD_DIR
	string
	default "hewlett_packard/hp_probook_6560b"

config MAINBOARD_PART_NUMBER
	string
	default "HP ProBook 6560b"

config VGA_BIOS_ID
	string
	default "8086,0116"

config DRAM_RESET_GATE_GPIO # FIXME: check this
	int
	default 60

config USBDEBUG_HCD_INDEX # FIXME: check this
	int
	default 2
endif
```

## src/mainboard/hp/snb_ivb_laptops/variants/probook_6560b/Kconfig.name
```kconfig
## SPDX-License-Identifier: GPL-2.0-only

config BOARD_HEWLETT_PACKARD_HP_PROBOOK_6560B
	bool "HP ProBook 6560b"
```
